## components/clock_scope_probe/Kconfig
```kconfig
menu "Clock scope diagnostic"
config CLOCK_SCOPE_PROBE
    bool "Enable experimental synchronized timing pulses"
    default n
    depends on IDF_TARGET_ESP32P4 || IDF_TARGET_ESP32C6
    help
        Hardware timer pulses on P4 GPIO45 or endpoint C6 GPIO18.
        P4 requires Waveshare P4-WIFI6-POE-ETH wiring; enables LDO4 at 3.3 V.
        Includes scheduling diagnostics; does not enable FTM discipline.
endmenu
```

## components/ftm_clock_probe/Kconfig
```kconfig
menu "FTM clock mapping diagnostics"
    config FTM_CLOCK_PROBE
        bool "Measure P4/C6 clock mapping over custom RPC"
        default n
        help
            Diagnostic only. Logs timestamp exchanges without adjusting clocks.
            Enable on both the P4 bridge and its C6 coprocessor.
    config FTM_CLOCK_PROBE_EDGE
        bool "Probe onboard P4 GPIO6 to C6 GPIO2 edge capture"
        depends on FTM_CLOCK_PROBE
        default n
        select GPTIMER_CTRL_FUNC_IN_IRAM
        select PCNT_CTRL_FUNC_IN_IRAM
        help
            Diagnostic for the Waveshare ESP32-P4-WIFI6-POE-ETH only.
            Captures GPIO6 pulses on the P4 and GPIO2 on the C6.
            Requires the board's R52 connection. Does not discipline clocks.
    config FTM_CLOCK_PROBE_BRIDGE_MAP
        bool "Validate live radio-to-upstream clock mapping"
        depends on FTM_CLOCK_PROBE_EDGE && IDF_TARGET_ESP32P4
        default n
        help
            Task-context prediction check, does not steer a clock or publish IEs.
    config FTM_CLOCK_PROBE_CORE_AUDIT
        bool "Compare PTP register capture brackets on both P4 cores"
        depends on FTM_CLOCK_PROBE_EDGE && IDF_TARGET_ESP32P4
        default n
        help
            Runs a finite read-only comparison before emitting shared edges.
    config FTM_CLOCK_PROBE_FOLLOW_UP
        bool "Publish mapped FTM FollowUp timing"
        depends on FTM_CLOCK_PROBE_EDGE
        default n
        help
            Transfers coherent source snapshots to the onboard radio and
            fills FTM FollowUp IEs at the reported transmit timestamp.
            Enable on both boards; P4 also requires BRIDGE_MAP.
    config FTM_CLOCK_PROBE_FAULT_TEST
        bool "Run one missing-edge, extra-edge and ignored-ack test"
        depends on FTM_CLOCK_PROBE_EDGE && IDF_TARGET_ESP32P4
        default n
        help
            Finite diagnostic faults on arm sequences 3, 5 and 7.
            No clock discipline uses these observations.
endmenu
```

## components/ftm_endpoint/Kconfig
```kconfig
menu "FTM endpoint timing"
    config FTM_ENDPOINT
        bool "Receive mapped FTM FollowUp observations"
        depends on IDF_TARGET_ESP32C6 && FTM_LOCAL_CLOCK
        default n
    config FTM_ENDPOINT_DISCIPLINE
        bool "Discipline the software clock using received FTM timing"
        depends on FTM_ENDPOINT
        default n
    config FTM_ENDPOINT_SIGNED_RTT_EXPERIMENT
        bool "Clock experiment with small signed RTT estimates"
        depends on FTM_ENDPOINT_DISCIPLINE && FTM_FAILURE_RETAIN
        default n
        help
            Diagnostic only. Retains signed rate-corrected RTT estimates
            down to -25 ns without clamping or calibration offsets. This
            guard is an experiment limit, not a calibrated error bound.
    config FTM_ENDPOINT_PAIR_SELECTION
        bool "Use independent directional FTM timestamp minima"
        depends on FTM_ENDPOINT_DISCIPLINE
        default n
        help
            Select forward and reverse timestamps independently over the
            admitted matched quartets. Recheck the combined delay guard.
            The SDK burst fallback remains an experimental dependency.
    config FTM_ENDPOINT_PAIR_SHADOW
        bool "Compare independent directional timestamp selection"
        depends on FTM_ENDPOINT_DISCIPLINE
        default n
        help
            Log alternative forward/reverse minima once per eight reports.
            Diagnostic only, does not alter the clock observation or servo.
    config FTM_ENDPOINT_LOSS_TEST
        bool "Suppress timing observations for five seconds after startup"
        depends on FTM_ENDPOINT_DISCIPLINE
        default n
        help
            Finite diagnostic. Between 60 and 65 seconds after boot, consume
            reports normally but withhold their clock observations. Announce
            reception continues. Repeats only after a reboot.
endmenu
```

## components/ftm_failure_probe/Kconfig
```kconfig
menu "FTM failure investigation"
config FTM_FAILURE_PROBE
    bool "Capture rejected reports inside the audited C6 Wi-Fi blob"
    default n
    depends on IDF_TARGET_ESP32C6
    help
        Diagnostic only. Exposes three private data symbols in a build-local
        copy of an exact hash-checked blob object. Copies reports before
        driver cleanup, then formats them in a separate task.
config FTM_FAILURE_RETAIN
    bool "Retain discarded quartets and vendor IEs for clock experiments"
    default n
    depends on FTM_FAILURE_PROBE
    help
        Exact-blob diagnostic only. Copies records before cleanup without
        changing timestamps or driver classification. Suppresses verbose
        report logging. Not a portable replacement for a vendor API fix.
config FTM_FAILURE_RX_METADATA
    bool "Capture raw RX descriptor timing fields"
    default n
    depends on FTM_FAILURE_PROBE
    help
        Diagnostic only, gated by the audited wdev and hal_mac object hashes.
        Copies timing fields after the existing hardware timestamp read.
        Adds bounded copying and a short lock to the receive path.
config FTM_FAILURE_ASSOC_TEST
    bool "Disconnect during the fifth FTM session"
    default n
    depends on FTM_FAILURE_PROBE
    help
        Diagnostic only. Disconnect 50 ms after the fifth accepted session
        start to exercise late-report rejection and reassociation recovery.
        Repeats after reboot; restore a build with this option disabled.
config FTM_FAILURE_RESET_TEST
    bool "Run one reconnect and one radio restart after baseline capture"
    default n
    depends on FTM_FAILURE_PROBE
    help
        Diagnostic only. At 60 seconds after the first report, disconnect
        and let the application reconnect. At 120 seconds stop/start Wi-Fi.
        Log completion at 180 seconds. Repeats after each endpoint reboot.
endmenu
```

## components/ftm_local_clock/Kconfig
```kconfig
menu "FTM local clock mapping"
config FTM_LOCAL_CLOCK
    bool "Continuously measure C6 MAC to SYSTIMER mapping"
    depends on IDF_TARGET_ESP32C6
    default n
    help
        Experimental read-only mapping. Does not steer the PTP clock.
        Publishes fresh bounded snapshots and invalidates on discontinuity.
endmenu
```

## components/ftm_raw_probe/Kconfig
```kconfig
menu "Raw FTM clock experiment"
config FTM_RAW_PROBE
    bool "Queue raw FTM timestamps for clock model validation"
    default n
    depends on IDF_TARGET_ESP32C6
    help
        Records existing reports without changing ranging or clock discipline.
        Bounded nonblocking copies feed a separate logging task.
config FTM_LIVE_MODEL
    bool "Evaluate relative FTM clock model without discipline"
    default n
    depends on FTM_RAW_PROBE
config FTM_LIVE_MODEL_SELF_TEST
    bool "Exercise model expiry and one wireless rejoin"
    default n
    depends on FTM_LIVE_MODEL
    help
        Diagnostic only: pause model input after one minute and request
        one Wi-Fi disconnect after six minutes. Repeats on each boot.
endmenu
```

## components/ftm_responder_probe/Kconfig
```kconfig
menu "FTM responder investigation"
config FTM_RESPONDER_PROBE
    bool "Capture responder hardware and converted FTM timestamps"
    default n
    depends on IDF_TARGET_ESP32C6
    help
        Diagnostic only, requires exact audited Wi-Fi object hashes.
        Copies timestamps after the existing driver callback and queues
        records without waiting. Formatting runs in a separate task.
config FTM_RESPONDER_RX_METADATA
    bool "Capture responder fine timestamp register fields"
    default n
    depends on FTM_RESPONDER_PROBE
    help
        Diagnostic only. Reads timestamp slots after the driver callback.
        Requires an exact stable reconstruction of both hardware timestamps.
endmenu
```

## components/mac_transition_probe/Kconfig
```kconfig
menu "MAC transition diagnostic"
config MAC_TRANSITION_PROBE
    bool "Measure MAC transitions against a hardware timer"
    default n
    depends on IDF_TARGET_ESP32C6
    help
        Bounded clock mapping experiment. Uses one additional GPTimer.
        Does not change synchronization or drive any GPIO.
config MAC_TRANSITION_MCPWM
    bool "Use directly readable MCPWM counter"
    default n
    depends on MAC_TRANSITION_PROBE && SOC_MCPWM_SUPPORTED
    help
        Compare fine phase modulo 1.5 ms using an unconnected MCPWM timer.
config MAC_TRANSITION_DIRECT_READ
    bool "Use verified C6 MAC register instead of API call"
    default n
    depends on MAC_TRANSITION_MCPWM
    help
        C6 diagnostic only. Requires rechecking the SDK getter disassembly.
endmenu
```
